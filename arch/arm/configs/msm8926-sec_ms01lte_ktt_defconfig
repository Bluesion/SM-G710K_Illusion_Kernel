## arch/arm/configs/msm8926-sec_ms01lte_ktt_defconfig
```kconfig
#variant defconfig
CONFIG_MACH_MS01_KOR_LTE=y

#Power Management
#CONFIG_SEC_PM=n

#LCD
#CONFIG_ESD_ERR_FG_RECOVERY is not set
#CONFIG_MDNIE_LITE_TUNING=y

#SvcLED
#CONFIG_LEDS_AN30259A=y

#VIBRATOR
#CONFIG_VIBETONZ=y
#CONFIG_MOTOR_DRV_DRV2603=y

#SENSORS
#CONFIG_INPUT_YAS_MAGNETOMETER_POSITION=3
#CONFIG_SENSORS_CM36651=y
#CONFIG_INPUT=y
#CONFIG_INPUT_MPU6500=y
#CONFIG_INPUT_MPU6500_POLLING=y
#CONFIG_SENSORS_YAS532=y
#CONFIG_MPU6500_ADJUST_SMART_ALERT=y
#CONFIG_YAS_MAG_DRIVER_YAS532=y
#CONFIG_INPUT_YAS_SENSORS=y
#CONFIG_YAS_MAG_MULTI_SUPPORT=y
#CONFIG_INPUT_YAS_ACCELEROMETER is not set
#CONFIG_INPUT_YAS_MAGNETOMETER=y
#CONFIG_YAS_ACC_DRIVER_BMA250 is not set
#CONFIG_INPUT_MPU6500_SELFTEST=y

#CAMERA

#USB
#CONFIG_USB_DUN_SUPPORT=y

#CONFIG_USB_ANDROID_SAMSUNG_SIDESYNC=y

#USB Host
#CONFIG_USB_HOST_NOTIFY=y
#CONFIG_USB_STORAGE_DETECT=y
#CONFIG_USB_NET_SMSC75XX=y
#CONFIG_USB_NET_SMSC95XX=y

#MUIC
#CONFIG_MFD_MAX77693=y
#CONFIG_USB_SWITCH_MAX77693=y
#CONFIG_REGULATOR_MAX77693=y
#CONFIG_DI_MUIC=n
#CONFIG_MUIC_INIT_DETECT_DELAY=3000
#CONFIG_MUIC_USB_DETECT_DELAY=17000
#CONFIG_SM5502_MUIC=y
#CONFIG_TORCH_FIX=y
# IRDA support
# CONFIG_IR_REMOCON_MC96 is not set

#NFC
#CONFIG_NFC_PN547=y
#CONFIG_NFC_PN547_8226_USE_BBCLK2=y

# CODEC
#CONFIG_SND_SOC_MAX98504 is not set

# GPIO DVS
CONFIG_SEC_GPIO_DVS=y

# QCOM DEBUG
#CONFIG_MSM_RTB=y
#CONFIG_MSM_RTB_SEPARATE_CPUS=y

# DO NOT EXT OVP
CONFIG_ARCH_MSM8926_LTE=y

# DMB
CONFIG_TDMB=y
CONFIG_TDMB_VENDOR_FCI=y
CONFIG_TDMB_FC8080=y
CONFIG_TDMB_SPI=y

# Ringback tone gain devide
CONFIG_SEC_DEVIDE_RINGTONE_GAIN=y

# Illusion Kernel Settings
CONFIG_LTO=y
```
